## prj.conf
```kconfig
CONFIG_LOG=y
CONFIG_FLASH=y
CONFIG_FLASH_PAGE_LAYOUT=y
CONFIG_NVS=y
```

## prj_nrf52840_pca10059.conf
```kconfig
CONFIG_LOG=y

CONFIG_FLASH=y
CONFIG_FLASH_PAGE_LAYOUT=y
CONFIG_FLASH_MAP=y
CONFIG_NVS=y
CONFIG_MPU_ALLOW_FLASH_WRITE=y

# CONFIG_GPIO=y
# CONFIG_USB=y
# CONFIG_USB_DEVICE_STACK=y
# CONFIG_USB_DEVICE_VID=0x2FE9

# CONFIG_TRACING=y
# CONFIG_TRACING_CTF=y
# CONFIG_TRACING_ASYNC=y
# CONFIG_TRACING_BACKEND_USB=y
# CONFIG_TRACING_HANDLE_HOST_CMD=y
# CONFIG_TRACING_BUFFER_SIZE=4096

CONFIG_GPIO=y
CONFIG_USB=y
CONFIG_USB_DEVICE_STACK=y
CONFIG_USB_DEVICE_PRODUCT="Zephyr USB console sample"
CONFIG_USB_UART_CONSOLE=y

CONFIG_UART_INTERRUPT_DRIVEN=y
CONFIG_UART_LINE_CTRL=y
CONFIG_UART_CONSOLE_ON_DEV_NAME="CDC_ACM_0"

CONFIG_USB_UART_DTR_WAIT=y

CONFIG_TRACING=y
CONFIG_TRACING_CPU_STATS=y
CONFIG_TRACING_CPU_STATS_LOG=n

CONFIG_TEST_RANDOM_GENERATOR=y
CONFIG_TIMER_RANDOM_GENERATOR=y
```

## include/board.h
```c
#ifndef __BOARD_H__
#define __BOARD_H__

#include "zephyr/types.h"

int board_sensor_a_last_data_get(u8_t *last_data);

int board_sensor_a_last_data_set(u8_t *last_data);

#endif
```

## src/board.c
```c
#include <logging/log.h>
#include <zephyr.h>
#include "kernel.h"

#include "board.h"

LOG_MODULE_REGISTER(board, 4);

K_MSGQ_DEFINE(sensor_a_data_stream, 1, 10, 1);
K_MSGQ_DEFINE(sensor_b_data_stream, 1, 10, 1);
K_MSGQ_DEFINE(sensor_c_data_stream, 4, 10, 4);

K_SEM_DEFINE(sensor_a_sem, 1, 1);

static u8_t __sensor_a_last_data = 0;

int board_sensor_a_last_data_get(u8_t *last_data)
{
    int error = k_sem_take(&sensor_a_sem, K_MSEC(500));
    if (!error) {
        *last_data = __sensor_a_last_data;
        k_sem_give(&sensor_a_sem);
    }
    return error;
}

int board_sensor_a_last_data_set(u8_t *last_data)
{
    int error = k_sem_take(&sensor_a_sem, K_MSEC(500));
    if (!error) {
        __sensor_a_last_data = *last_data;
        k_sem_give(&sensor_a_sem);
    }
    return error;
}

static u8_t get_sensor_a(void)
{
    static u8_t data_a = 20;

    data_a++;
    if (data_a > 40) {
        data_a = 20;
    }

    return data_a;
}

static u8_t get_sensor_b(void)
{
    static u8_t data_b = 90;

    data_b--;
    if (data_b < 40) {
        data_b = 90;
    }

    return data_b;
}

static u32_t get_sensor_c(void)
{
    static u32_t data_c = 101325;

    data_c += 27;
    if (data_c > 102000) {
        data_c = 101325;
    }

    return data_c;
}

void BOARD_task()
{
    LOG_DBG("BOARD Service has started...[OK]");
    u8_t sensor_a_data  = 0;
    u8_t sensor_b_data  = 0;
    u32_t sensor_c_data = 0;
    while (1) {
        sensor_a_data = get_sensor_a();
        board_sensor_a_last_data_set(&sensor_a_data);
        k_msgq_put(&sensor_a_data_stream, &sensor_a_data, K_MSEC(500));
        sensor_b_data = get_sensor_b();
        k_msgq_put(&sensor_b_data_stream, &sensor_b_data, K_MSEC(500));
        sensor_c_data = get_sensor_c();
        k_msgq_put(&sensor_c_data_stream, &sensor_c_data, K_MSEC(500));
        k_sleep(K_SECONDS(2));
    }
}

K_THREAD_DEFINE(BOARD, 512, BOARD_task, NULL, NULL, NULL, 3, 0, K_NO_WAIT);
```

## src/core.c
```c
#include <kernel.h>
#include <logging/log.h>
#include <string.h>
#include <zephyr.h>

#include "core.h"

#define MAX_RING_SIZE 11

LOG_MODULE_REGISTER(core, 4);

extern struct k_msgq net_request_msgq;      // from Net
extern struct k_msgq sensor_a_data_stream;  // from Sensor
extern struct k_msgq sensor_b_data_stream;  // from Sensor
extern struct k_msgq sensor_c_data_stream;  // from Sensor

K_MSGQ_DEFINE(net_uplink_msgq, 5, 10, 8);

K_SEM_DEFINE(core_last_data_sem, 1, 1);

static u8_t __last_data[5] = {0};

static u8_t ring_data_a[MAX_RING_SIZE];
static u8_t ring_data_b[MAX_RING_SIZE];
static u32_t ring_data_c[MAX_RING_SIZE];
static u8_t id_a;
static u8_t id_b;
static u8_t id_c;

int core_last_net_packet_get(u8_t *last_data)
{
    int error = k_sem_take(&core_last_data_sem, K_MSEC(500));
    if (!error) {
        memcpy(last_data, __last_data, 5);
        k_sem_give(&core_last_data_sem);
    }
    return error;
}

int core_last_net_packet_set(u8_t *last_data)
{
    int error = k_sem_take(&core_last_data_sem, K_MSEC(500));
    if (!error) {
        memcpy(__last_data, last_data, 5);
        k_sem_give(&core_last_data_sem);
    }
    return error;
}

static u16_t sensor_a_mean(void)
{
    u16_t sum = 0;
    int i     = 0;
    for (i = 0; i < MAX_RING_SIZE && ring_data_a[i] != 0; i++) {
        sum += ring_data_a[i];
    }

    LOG_DBG("A Mean -> i: %d, sum: %d, mean: %d", i, sum, sum / i);
    return sum / i;
}

static u16_t sensor_b_mean(void)
{
    u16_t sum = 0;
    int i     = 0;
    for (i = 0; i < MAX_RING_SIZE && ring_data_b[i] != 0; i++) {
        sum += ring_data_b[i];
    }

    LOG_DBG("B Mean -> i: %d, sum: %d, mean: %d", i, sum, sum / i);
    return sum / i;
}

static u32_t sensor_c_mean(void)
{
    u32_t sum = 0;
    int i     = 0;
    for (i = 0; i < MAX_RING_SIZE && ring_data_c[i] != 0; i++) {
        sum += ring_data_c[i];
    }

    LOG_DBG("C Mean -> i: %d, sum: %d, mean: %d", i, sum, sum / i);
    return sum / i;
}

static void core_process_sensors()
{
    u8_t data_u8 = {0};
    if (!k_msgq_get(&sensor_a_data_stream, &data_u8, K_NO_WAIT)) {
        ring_data_a[id_a] = data_u8;
        id_a              = (id_a + 1) % MAX_RING_SIZE;
        LOG_DBG("Data received from sensor A: %d", data_u8);
    }
    if (!k_msgq_get(&sensor_b_data_stream, &data_u8, K_NO_WAIT)) {
        ring_data_b[id_b] = data_u8;
        id_b              = (id_b + 1) % MAX_RING_SIZE;
        LOG_DBG("Data received from sensor B: %d", data_u8);
    }
    u32_t data_u32 = {0};
    if (!k_msgq_get(&sensor_c_data_stream, &data_u32, K_NO_WAIT)) {
        ring_data_c[id_c] = data_u32;
        id_c              = (id_c + 1) % MAX_RING_SIZE;
        LOG_DBG("Data received from sensor C: %d", data_u32);
    }
}

void CORE_task()
{
    LOG_DBG("CORE Service has started...[OK]");
    u8_t net_request     = 0;
    u8_t net_response[5] = {0};
    while (1) {
        net_request = 0;
        memset(net_response, 0, 5);
        core_process_sensors();
        if (!k_msgq_get(&net_request_msgq, &net_request, K_NO_WAIT)) {
            LOG_WRN("Net request: 0x%02x", net_request);
            net_response[0] = net_request;
            switch (net_request) {
            case 0xA0:
                net_response[1] = ring_data_a[(id_a == 0) ? MAX_RING_SIZE : id_a - 1];
                break;
            case 0xA1:
                net_response[1] = ring_data_b[(id_b == 0) ? MAX_RING_SIZE : id_b - 1];
                break;
            case 0xA2:
                memcpy(net_response + 1,
                       &ring_data_c[(id_c == 0) ? MAX_RING_SIZE : id_c - 1],
                       sizeof(u32_t));
                break;
            case 0xA3: {
                u16_t a_mean = sensor_a_mean();
                memcpy(net_response + 1, &a_mean, sizeof(u16_t));
            } break;
            case 0xA4: {
                u16_t b_mean = sensor_b_mean();
                memcpy(net_response + 1, &b_mean, sizeof(u16_t));
            } break;
            case 0xA5: {
                u32_t c_mean = sensor_c_mean();
                memcpy(net_response + 1, &c_mean, sizeof(u32_t));
            } break;
            default:
                LOG_ERR("Request code wrong: 0x%02x", net_request);
            }
            core_last_net_packet_set(net_response);
            k_msgq_put(&net_uplink_msgq, net_response, K_MSEC(100));
        }
        k_sleep(K_SECONDS(3));
    }
}

K_THREAD_DEFINE(CORE, 512, CORE_task, NULL, NULL, NULL, 3, 0, 0);
```

## src/net.c
```c
#include <logging/log.h>
#include <stdlib.h>
#include <zephyr.h>
#include "kernel.h"

LOG_MODULE_REGISTER(net, 4);

extern struct k_msgq net_uplink_msgq;  // from Core

K_MSGQ_DEFINE(net_request_msgq, 1, 10, 1);

u8_t generate_random_number(u8_t lower, u8_t upper)
{
    return (sys_rand32_get() % (upper - lower + 1)) + lower;
}

static void handle_net_requests(void)
{
    u8_t num            = generate_random_number(1, 36);
    u8_t packet_request = 0;
    if (num <= 6) {
        packet_request = 0xA0;
    } else if (num <= 12) {
        packet_request = 0xA1;
    } else if (num <= 18) {
        packet_request = 0xA2;
    } else if (num <= 24) {
        packet_request = 0xA3;
    } else if (num <= 30) {
        packet_request = 0xA4;
    } else if (num <= 36) {
        packet_request = 0xA5;
    }
    LOG_DBG("Getting a virtual packet request from net with id: %02X", packet_request);
    LOG_DBG("Sending a net packet request to NET_REQUEST channel...");
    k_msgq_put(&net_request_msgq, &packet_request, K_MSEC(500));
}

static void net_handle_channel_callback(u8_t *net_response)
{
    LOG_DBG("Net response received: %02X", net_response[0]);
    if (net_response[0] == 0xA0) {  // Requesting last A data
        LOG_DBG("Last sensor A data saved: %d", net_response[1]);
    } else if (net_response[0] == 0xA1) {  // Requesting last B data
        LOG_DBG("Last sensor B data saved: %d", net_response[1]);
    } else if (net_response[0] == 0xA2) {  // Requesting last C data
        u32_t c_value = 0;
        memcpy(&c_value, net_response + 1, sizeof(u32_t));
        LOG_DBG("Last sensor C data saved: %d", c_value);
    } else if (net_response[0] == 0xA3) {  // Requesting A mean
        u16_t a_mean = 0;
        memcpy(&a_mean, net_response + 1, sizeof(u16_t));
        LOG_DBG("Current A mean: %d", a_mean);
    } else if (net_response[0] == 0xA4) {  // Requesting B mean
        u16_t b_mean = 0;
        memcpy(&b_mean, net_response + 1, sizeof(u16_t));
        LOG_DBG("Current B mean: %d", b_mean);
    } else if (net_response[0] == 0xA5) {  // Requesting C mean
        u32_t c_mean = 0;
        memcpy(&c_mean, net_response + 1, sizeof(u32_t));
        LOG_DBG("Current C mean: %d", c_mean);
    } else {
        LOG_DBG("Net response sent is invalid!");
    }
}

void NET_task()
{
    LOG_DBG("NET Service has started...[OK]");
    u8_t net_packet[5] = {0};
    while (1) {
        k_sleep(K_SECONDS(9));
        handle_net_requests();
        k_sleep(K_SECONDS(1));
        if (!k_msgq_get(&net_uplink_msgq, net_packet, K_NO_WAIT)) {
            net_handle_channel_callback(net_packet);
        }
        u32_t per = cpu_stats_non_idle_and_sched_get_percent();
        LOG_WRN("CPU usage: %u%%\n", per);
        cpu_stats_reset_counters();
    }
}

K_THREAD_DEFINE(NET, 512, NET_task, NULL, NULL, NULL, 2, 0, 0);
```

## src/storage.c
```c
#include <drivers/flash.h>
#include <fs/nvs.h>
#include <kernel.h>
#include <logging/log.h>
#include <storage/flash_map.h>
#include <zephyr.h>
#include "board.h"
#include "core.h"

LOG_MODULE_REGISTER(storage, 4);

/* #define NVS_SECTOR_SIZE DT_FLASH_ERASE_BLOCK_SIZE */
/* #define NVS_SECTOR_COUNT 4 */
/* #define NVS_STORAGE_OFFSET DT_FLASH_AREA_STORAGE_OFFSET */

static struct nvs_fs zt_fs;

void store()
{
    u8_t sensor_data = 0;
    board_sensor_a_last_data_get(&sensor_data);
    int rc = nvs_write(&zt_fs, 0, &sensor_data, 1);
    if (rc > 0) { /* item was found, show it */
        LOG_INF("Id: %d", 0);
        LOG_HEXDUMP_INF(&sensor_data, 1, "Stored sensor data: ");
    } else { /* item was not found, add it */
        LOG_INF("Could not store sensor data error: %d", rc);
    }

    u8_t net_data[5] = {0};
    core_last_net_packet_get(net_data);
    rc = nvs_write(&zt_fs, 1, net_data, 5);
    if (rc > 0) { /* item was found, show it */
        LOG_INF("Id: %d", 1);
        LOG_HEXDUMP_INF(&net_data, 5, "Stored net data: ");

    } else { /* item was not found, add it */
        LOG_INF("Could not store net data error: %d", rc);
    }
}

void restore()
{
    u8_t sensor_data = 0;
    int rc           = nvs_read(&zt_fs, 0, &sensor_data, 1);
    if (rc > 0) { /* item was found, show it */
        LOG_INF("Id: %d", 0);
        LOG_HEXDUMP_INF(&sensor_data, 1, "Recovered sensor data: ");
        board_sensor_a_last_data_set(&sensor_data);
    } else { /* item was not found, add it */
        LOG_INF("No values found for sensor data");
    }

    u8_t net_data[5] = {0};
    rc               = nvs_read(&zt_fs, 1, net_data, 5);
    if (rc > 0) { /* item was found, show it */
        LOG_INF("Id: %d", 1);
        LOG_HEXDUMP_INF(&net_data, 5, "Recovered net data: ");
        core_last_net_packet_set(net_data);
    } else { /* item was not found, add it */
        LOG_INF("No values found for net data");
    }
    LOG_DBG("Restoring data from flash");
}
void STORAGE_task(void)
{
    struct flash_pages_info info;
    zt_fs.offset = FLASH_AREA_OFFSET(storage);
    int rc       = flash_get_page_info_by_offs(
        device_get_binding(DT_CHOSEN_ZEPHYR_FLASH_CONTROLLER_LABEL), zt_fs.offset, &info);
    if (rc) {
        printk("Unable to get page info");
    }
    zt_fs.sector_size  = info.size;
    zt_fs.sector_count = 3U;
    rc                 = nvs_init(&zt_fs, DT_CHOSEN_ZEPHYR_FLASH_CONTROLLER_LABEL);
    if (rc) {
        LOG_INF("Flash Init failed");
    } else {
        LOG_INF("NVS started...[OK]");
    }
    restore();
    while (1) {
        k_sleep(K_SECONDS(30));
        store();
    }
}

K_THREAD_DEFINE(STORAGE, 512, STORAGE_task, NULL, NULL, NULL, 5, 0, 0);
```
